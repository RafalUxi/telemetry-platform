## firmware/main/Kconfig.projbuild
```kconfig
menu "Telemetry device"

config WIFI_MAX_RETRY
    int "Maximum connection attempts before giving up"
    default 5

config I2C_SDA_GPIO
    int "I2C SDA pin"
    default 21

config I2C_SCL_GPIO
    int "I2C SCL pin"
    default 22

config SAMPLE_INTERVAL_MS
    int "Milliseconds between measurements"
    default 1000

config BUFFER_MAX
    int "How many samples the device keeps when offline"
    default 500

config BATCH_MAX
    int "How many samples go into one message"
    default 50

endmenu
```
